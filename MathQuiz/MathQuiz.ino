/*
 * A simple math quiz game that can be played on an OLED screen.
 * The game uses a potentiometer and a pushbutton for user INPUT.
 * It generates questions in a using a defined format but with random numbers.
 * For circuit diagram and other details visit www.curiousmotor.com
 * to add more levels all variables marked with //##CHANGE need to be changed
 */


#include <SPI.h>
#include <Wire.h>
#include <Adafruit_GFX.h>
#include <Adafruit_SSD1306.h>

#define SCREEN_WIDTH 128 // OLED display width, in pixels
#define SCREEN_HEIGHT 64 // OLED display height, in pixels
#define PUSHBUTTON 2 // Pushbutton is connected to pin 2
#define POTENTIOMETER A0 //Potentiometer output is wired to A0
// Declaration for an SSD1306 display connected to I2C (SDA, SCL pins)
#define OLED_RESET     -1 // Reset pin # (or -1 if sharing Arduino reset pin)
Adafruit_SSD1306 display(SCREEN_WIDTH, SCREEN_HEIGHT, &Wire, OLED_RESET);

int score= 0; // Keep track of score
int correctAnswer; //correct solution of the question
String equation; // String to store the question
int x,y,z; //variables for numbers in questions, declared here for global scope
int ansUpperLimit; // upperlimit for potentiometer value
int ansLowerLimit; // lowerlimit for potentiometer value
int level=1; // Decided variety of questions
int prevLevelUp;
const int maxlevel=2; //the max level you've programmed for    ##CHANGE    
volatile int selectedAnswer; // answer selected by user
#define LOGO_HEIGHT   64
#define LOGO_WIDTH    128
// Below is the splash screen for the curiousmotor logo- (can be removed)
const unsigned char logo_bmp [] PROGMEM = {
  0x00, 0x00, 0x00, 0x00, 0x00, 0x00, 0x00, 0x00, 0x00, 0x00, 0x00, 0x00, 0x00, 0x00, 0x00, 0x00, 
  0x00, 0x00, 0x00, 0x00, 0x00, 0x00, 0x00, 0x00, 0x00, 0x00, 0x00, 0x00, 0x00, 0x00, 0x00, 0x00, 
  0x00, 0x00, 0x00, 0x00, 0x00, 0x00, 0x00, 0x00, 0x00, 0x00, 0x00, 0x00, 0x00, 0x00, 0x00, 0x00, 
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  0x00, 0x00, 0x00, 0x00, 0x00, 0x00, 0x00, 0x00, 0x00, 0x00, 0x00, 0x00, 0x00, 0x00, 0x00, 0x00
};


//Function to draw the curiousmotor splash screen
void testdrawbitmap(void) {
  display.clearDisplay();
  display.drawBitmap(
    (display.width()  - LOGO_WIDTH ) / 2,
    (display.height() - LOGO_HEIGHT) / 2,
    logo_bmp, LOGO_WIDTH, LOGO_HEIGHT, 1);
  display.display();
  delay(1000);
} 

void setup() {
  Serial.begin(9600);
    if(!display.begin(SSD1306_SWITCHCAPVCC, 0x3C)) { // Address 0x3C for 128x32
      Serial.println(F("SSD1306 allocation failed"));
      for(;;); // Don't proceed, loop forever
  }
  display.clearDisplay(); 
  display.display();
  testdrawbitmap();    
  delay(3000);
  display.clearDisplay();
  display.setTextWrap(true);
 
  pinMode(PUSHBUTTON, INPUT_PULLUP); // Declare the pushbutton as input
  newQuestion();
}

void loop() {
  displayEquation(equation);
  displayAnswerOptions();
  display.display();
  
  if(digitalRead(PUSHBUTTON)==LOW){
    checkAndProceed();
    delay(1000);
  }
  display.clearDisplay();
}

void displayAnswerOptions(){
  display.setTextSize(2);   
  display.setTextColor(SSD1306_WHITE);        // Draw white text
  display.setCursor(0,SCREEN_HEIGHT/2+5); 
  selectedAnswer= map(analogRead(POTENTIOMETER), 0, 1023, ansLowerLimit, ansUpperLimit); //Map pot values that range from 0-1023 to upper and lower limit values depending on the question's nswer
  display.println("Ans= " + String(selectedAnswer)); 
}

//Function to display question
void displayEquation(String equation){
  display.setTextSize(2);             // Normal 1:1 pixel scale
  display.setTextColor(SSD1306_WHITE);        // Draw white text
  display.setCursor(0,0); 
  display.println(equation);

}

//Function to check user's answer and proceed
void checkAndProceed(void){
  display.clearDisplay();
  //if correct then proceed else cut one point.
  if(correctAnswer==selectedAnswer){
    score++;
    display.setCursor(0,SCREEN_HEIGHT/2-15);
    display.setTextSize(2); 
    display.println("Correct!");  
    display.setCursor(0,SCREEN_HEIGHT/2);
    display.setTextSize(1); 
    display.println("Score= " + String(score));
    if (score-prevLevelUp>5 && level+1<=maxlevel){
        levelup();
    }

  }
  else{
    resetGame();
  }
  newQuestion();
  display.display();
  delay(1000);
  display.clearDisplay();
}

//function to generate new question
void newQuestion(void){
  x=random(0,12);
  y=random(0,12);
  z=random(0,12);
  int r = random(0, level);//as level increases, variety of questions increases
  //Add your questions and answers below by following the example below
  String equationSet[]={String(x)+"*("+String(y)+"+"+String(z)+")= ?" , "("+String(x)+"+"+String(y)+")"+"("+String(x)+"-"+String(y)+")"}; //##CHANGE
  int answerSet[]={x*(y+z), x*x-y*y}; //##CHANGE
  equation= equationSet[r];
  correctAnswer=answerSet[r];
  ansUpperLimit=correctAnswer + random(0,10);
  ansLowerLimit=correctAnswer - random(0,10);
}

//resetGame and display score
void resetGame(void){
  level=1;
  score=0;
  display.setCursor(0,SCREEN_HEIGHT/2-15);
  display.setTextSize(1); 
  display.println("-Game Over-");  
  display.setCursor(0,SCREEN_HEIGHT/2);
   display.setTextSize(1); 
  display.println("Score= " + String(score));
  display.println();
  display.println("The correct answer is " + String(correctAnswer));
  display.display();
  delay(3000);
}

void levelup(void){
  level++;
  display.clearDisplay();
  display.setCursor(0,SCREEN_HEIGHT/2-15);
  display.setTextSize(2); 
  display.println("LEVEL "+ String(level)+ "!");  
  display.display();
  delay(2000);
}
